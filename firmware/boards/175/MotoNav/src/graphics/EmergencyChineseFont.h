#pragma once
// Offline 24x24 labels derived from the bundled GNU Unifont Chinese font.
// Source: GFX_Library_for_Arduino/src/font/u8g2_font_unifont_h_chinese4.h.
// Copyright (C) 1998-2025 Roman Czyborra, Paul Hardy, Qianqian Fang,
// Andrew Miller, Johnnie Weaver, David Corbett, Minseo Lee and contributors.
// License: SIL Open Font License 1.1 / GPLv2+ with GNU Font Embedding Exception.
// Only fixed labels are embedded; custom text arrives as grayscale bitmaps.
#include <stdint.h>
static const uint32_t EMERGENCY_CN_CODEPOINTS[] = {
  0x6025, 0x5239, 0x62A5, 0x8B66, 0x6D4B, 0x8BD5, 0x624B, 0x673A, 0x5DF2, 0x8FDE, 0x63A5, 0x84DD,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 0x5E55
 };
static const uint8_t EMERGENCY_CN_BITMAPS[][72] PROGMEM = {
  {0x00, 0x40, 0x00, 0x01, 0xFF, 0xC0, 0x01, 0xFF, 0xC0, 0x02, 0x01, 0x80, 0x02,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 0x00, 0x00}, // 急
  {0x00, 0x30, 0x06, 0x04, 0x30, 0x06, 0x04, 0x30, 0x06, 0x02, 0x41, 0x86, 0x02,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 0x00, 0x00}, // 刹
  {0x04, 0x00, 0x00, 0x04, 0x3F, 0xF8, 0x04, 0x3F, 0xF8, 0x04, 0x30, 0x08, 0x04,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 0x38, 0x06}, // 报
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  {0x01, 0x80, 0x40, 0x7F, 0xFF, 0xFF, 0x7F, 0xFF, 0xFF, 0x01, 0x80, 0x40, 0x01,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 0x00, 0x00}, // 幕
};

static inline uint32_t emergencyCnNextCodepoint(const char *&text) {
  const uint8_t first = uint8_t(*text++);
  if (first < 0x80) return first;
  uint32_t cp = first & (first < 0xE0 ? 0x1F : 0x0F);
  const int extra = first < 0xE0 ? 1 : 2;
  for (int i = 0; i < extra; ++i) {
    if (!*text) return 0;
    cp = (cp << 6) | (uint8_t(*text++) & 0x3F);
  }
  return cp;
}
static inline void drawEmergencyCnText(const char *text, int cx, int y, uint16_t color) {
  int count = 0;
  const char *at = text;
  while (*at) { emergencyCnNextCodepoint(at); ++count; }
  int x = cx - count * 24 / 2;
  while (*text) {
    const uint32_t cp = emergencyCnNextCodepoint(text);
    for (size_t g = 0; g < sizeof(EMERGENCY_CN_CODEPOINTS) / sizeof(EMERGENCY_CN_CODEPOINTS[0]); ++g) {
      if (EMERGENCY_CN_CODEPOINTS[g] != cp) continue;
      for (int yy = 0; yy < 24; ++yy) {
        for (int xx = 0; xx < 24; ++xx) {
          if (pgm_read_byte(&EMERGENCY_CN_BITMAPS[g][yy * 3 + xx / 8]) & (0x80 >> (xx % 8)))
            gfx->drawPixel(x + xx, y + yy, color);
        }
      }
      break;
    }
    x += 24;
  }
}
